## config/west.yml
```yaml
manifest:
  defaults:
    revision: &zmk-rev v0.3
  remotes:
    - name: zmkfirmware
      url-base: https://github.com/zmkfirmware
    - name: urob
      url-base: https://github.com/urob
    - name: joelspadin
      url-base: https://github.com/joelspadin
    - name: nguyendown
      url-base: https://github.com/nguyendown
  projects:
    - name: zmk
      remote: zmkfirmware
      import: app/west.yml
    - name: zmk-helpers
      remote: urob
      revision: *zmk-rev
    - name: zmk-locales
      remote: joelspadin
      revision: v1.1.0
    - name: zmk-behavior-socd
      remote: nguyendown
      revision: main
  self:
    path: config
```
